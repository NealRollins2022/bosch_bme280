## drivers/sensor/bme280/Kconfig
```kconfig
config MYBME280
	bool "Enable Bosch BME280 environmental sensor driver (Custom Off-Tree)"
	select SENSOR
	select LOG
	select I2C
	select I2C_NRFX
	default n
	help
	  Bosch BME280 I2C environmental sensor driver.
	  Provides temperature, humidity, and pressure measurements.
	  Custom off-tree driver to avoid conflicts with built-in BME280.

if MYBME280

choice BOSCH_BME280_TRANSPORT
	prompt "Telemetry transport"
	default BOSCH_BME280_TRANSPORT_MATTER

config MYBME280_TRANSPORT_MATTER
	bool "Matter/CHIP (network)"
	select NET_IPV6
	select NET_UDP
	select NET_SOCKETS
	help
	  Send telemetry via Matter/Thread when network ready.

config MYBME280_TRANSPORT_SERIAL
	bool "Serial/UART (debug)"
	help
	  Output readings to UART.

endchoice

choice BOSCH_BME280_MODE
	prompt "Measurement mode"
	default BOSCH_BME280_MODE_CONTINUOUS

config MYBME280_MODE_CONTINUOUS
	bool "Continuous (driver thread polls sensor)"
	help
	  Driver thread reads sensor at interval.
	  Stores readings; signals bosch_bme280_data_ready_sem.

config MYBME280_MODE_ON_DEMAND
	bool "On-demand (app polls sensor)"
	help
	  Application calls sensor_sample_fetch() when needed.

endchoice

config MYBME280_MEASUREMENT_INTERVAL_MS
	int "Measurement interval (ms)"
	default 10000

config MYBME280_I2C_READ_TIMEOUT_MS
	int "I2C read timeout (ms)"
	default 2000
	depends on BOSCH_BME280_MODE_ON_DEMAND

config MYBME280_RETRY_COUNT
	int "I2C read retry count"
	default 5

config MYBME280_RETRY_DELAY_MS
	int "Retry delay (ms)"
	default 200

config MYBME280_INIT_PRIORITY
	int "Device init priority"
	default 85

config MYBME280_ACQ_THREAD_STACK_SIZE
	int "Acquisition thread stack (bytes)"
	default 2048
	depends on BOSCH_BME280_MODE_CONTINUOUS

config MYBME280_ACQ_THREAD_PRIORITY
	int "Acquisition thread priority"
	default 11
	depends on BOSCH_BME280_MODE_CONTINUOUS

config MYBME280_OVERSAMPLE_TEMP
	int "Temperature oversampling (1/2/4/8/16)"
	default 2
	range 1 16

config MYBME280_OVERSAMPLE_PRESS
	int "Pressure oversampling (1/2/4/8/16)"
	default 2
	range 1 16

config MYBME280_OVERSAMPLE_HUM
	int "Humidity oversampling (1/2/4/8/16)"
	default 2
	range 1 16

config MYBME280_I2C_ADDR_ALT
	bool "Use alternate I2C address (0x77 instead of 0x76)"
	default n
	help
	  BME280 can be configured at 0x76 (default) or 0x77.
	  Set this if SDO pin is pulled to VDD.

endif
```

## dts/bindings/sensor/FINAL_bosch,custom-bme280-i2c.yaml
```yaml
description: Bosch BME280 environmental sensor (I2C mode, custom off-tree)

compatible: "bosch,custom-bme280"

include: bosch,custom-bme280.yaml

on-bus: i2c
```

## dts/bindings/sensor/FINAL_bosch,custom-bme280.yaml
```yaml
description: Bosch BME280 environmental sensor (custom off-tree driver)

include: base.yaml
```

## dts/bindings/sensor/bosch,bme280-i2c.yaml
```yaml
description: Bosch BME280 environmental sensor (I2C mode)
compatible: "bosch,bme280"
include: bosch,bme280.yaml
on-bus: i2c
```

## dts/bindings/sensor/bosch,bme280.yaml
```yaml
description: Bosch BME280 environmental sensor base properties
include: base.yaml
```

## dts/bindings/sensor/bosch,mybme280.yaml
```yaml
description: Bosch BME280 environmental sensor base properties (custom off-tree driver)
include: base.yaml
```

## dts/bindings/sensor/mybme280_i2c.yaml
```yaml
description: Bosch BME280 environmental sensor (I2C mode, custom off-tree driver)
compatible: "bosch,mybme280-custom"
include: bosch,mybme280.yaml
on-bus: i2c
```
